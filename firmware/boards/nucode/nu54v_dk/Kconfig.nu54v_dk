## firmware/boards/nucode/nu54v_dk/Kconfig.nu54v_dk
```kconfig
config BOARD_NU54V_DK
	select SOC_NRF54L15_CPUAPP if BOARD_NU54V_DK_NRF54L15_CPUAPP
```

## firmware/boards/nucode/nu54v_dk/board.yml
```yaml
board:
  name: nu54v_dk
  full_name: NU54-DK (nRF54L15)
  vendor: nucode
  socs:
    - name: nrf54l15
```

## firmware/boards/nucode/nu54v_dk/nu54v_dk_nrf54l15_cpuapp_defconfig
```kconfig
# UART 콘솔 (VCOM1 : uart20)
CONFIG_SERIAL=y
CONFIG_CONSOLE=y
CONFIG_UART_CONSOLE=y

CONFIG_GPIO=y

CONFIG_ARM_MPU=y
```
